## boards/shields/dactyl/Kconfig.defconfig
```kconfig
if SHIELD_VIREAL_DACTYL_RIGHT

config ZMK_KEYBOARD_NAME
    default "vireal-dactyl-right"

config ZMK_SPLIT_ROLE_CENTRAL
    default y

endif

if SHIELD_VIREAL_DACTYL_LEFT

config ZMK_KEYBOARD_NAME
    default "vireal-dactyl-left"

endif

if SHIELD_VIREAL_DACTYL_RIGHT || SHIELD_VIREAL_DACTYL_LEFT

config ZMK_SPLIT
    default y

endif
```

## boards/shields/vireal_dactyl/Kconfig.defconfig
```kconfig
if SHIELD_VIREAL_DACTYL_RIGHT
config ZMK_KEYBOARD_NAME
    default "vireal-dactyl-r"
config ZMK_SPLIT_ROLE_CENTRAL
    default y
# Enable display on the central side (right)
config ZMK_DISPLAY
    default y
endif

if SHIELD_VIREAL_DACTYL_LEFT
config ZMK_KEYBOARD_NAME
    default "vireal-dactyl-l"
# Display on the left side too
config ZMK_DISPLAY
    default y
endif

if SHIELD_VIREAL_DACTYL_RIGHT || SHIELD_VIREAL_DACTYL_LEFT
config ZMK_SPLIT
    default y
config ZMK_STUDIO
    default n
endif

if ZMK_DISPLAY
    config I2C
        default y
    config SSD1306
        default y
    config ZMK_DISPLAY_BLANK_ON_IDLE
        default y
    config ZMK_DISPLAY_INVERT
        default y
endif # ZMK_DISPLAY
```
